## Kconfig
```kconfig
config CYGNUS_STATUS
    bool "Send keyboard status to the host over raw HID"
    default y
    depends on RAW_HID
```

## boards/shields/cygnus/Kconfig.defconfig
```kconfig
if SHIELD_CYGNUS_LEFT || SHIELD_CYGNUS_RIGHT || SHIELD_CYGNUS_DONGLE

config ZMK_SPLIT
    default y

endif

if SHIELD_CYGNUS_LEFT || SHIELD_CYGNUS_RIGHT

config ZMK_SPLIT_ROLE_CENTRAL
    default n

config BT_MAX_CONN
    default 1

config BT_MAX_PAIRED
    default 1

endif

if SHIELD_CYGNUS_DONGLE

config ZMK_KEYBOARD_NAME
    default "Cygnus"

config ZMK_SPLIT_ROLE_CENTRAL
    default y

config ZMK_SPLIT_BLE_CENTRAL_PERIPHERALS
    default 2

config ZMK_SPLIT_BLE_CENTRAL_BATTERY_LEVEL_FETCHING
    default y

config BT_MAX_CONN
    default 7

config BT_MAX_PAIRED
    default 7

endif
```

## config/west.yml
```yaml
manifest:
  defaults:
    revision: 4dd95d7840eb3d5a3f59bb29fbf1ab054715ef85
  remotes:
    - name: zmkfirmware
      url-base: https://github.com/zmkfirmware
    - name: zzeneg
      url-base: https://github.com/zzeneg
  projects:
    - name: zmk
      remote: zmkfirmware
      import: app/west.yml
    - name: zmk-raw-hid
      remote: zzeneg
      revision: 6a37765dfab6197292e7a9f47305dcf87386d56a
  self:
    path: config
```
